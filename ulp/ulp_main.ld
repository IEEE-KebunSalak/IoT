/* Variable definitions for ESP32ULP linker
 * This file is generated automatically by esp32ulp_mapgen.py utility.
 */

PROVIDE ( ulp_changed = 0x50000058 );
PROVIDE ( ulp_debounce_counter = 0x50000130 );
PROVIDE ( ulp_debounce_max_count = 0x50000134 );
PROVIDE ( ulp_edge_count = 0x50000144 );
PROVIDE ( ulp_edge_detected = 0x50000074 );
PROVIDE ( ulp_entry = 0x50000000 );
PROVIDE ( ulp_io_number = 0x50000148 );
PROVIDE ( ulp_next_edge = 0x5000012c );
PROVIDE ( ulp_pulse_cur = 0x5000013c );
PROVIDE ( ulp_pulse_detected = 0x500000d4 );
PROVIDE ( ulp_pulse_edge = 0x50000128 );
PROVIDE ( ulp_pulse_lower = 0x50000100 );
PROVIDE ( ulp_pulse_min = 0x50000140 );
PROVIDE ( ulp_pulse_res = 0x50000138 );
PROVIDE ( ulp_pulse_reset = 0x50000114 );
PROVIDE ( ulp_pulse_tick = 0x500000c0 );
PROVIDE ( ulp_read_now = 0x50000004 );
